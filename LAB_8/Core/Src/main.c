/* USER CODE BEGIN Header */
/**
  ******************************************************************************
  * @file           : main.c
  * @brief          : Main program body
  ******************************************************************************
  * @attention
  *
  * Copyright (c) 2026 STMicroelectronics.
  * All rights reserved.
  *
  * This software is licensed under terms that can be found in the LICENSE file
  * in the root directory of this software component.
  * If no LICENSE file comes with this software, it is provided AS-IS.
  *
  ******************************************************************************
  */
/* USER CODE END Header */
/* Includes ------------------------------------------------------------------*/
#include "main.h"
#include "i2c.h"
#include "rng.h"
#include "spi.h"
#include "tim.h"
#include "usart.h"
#include "gpio.h"

/* Private includes ----------------------------------------------------------*/
/* USER CODE BEGIN Includes */
#include "stdio.h"
#include "string.h"
#include "ILI9341_GFX.h"
#include "ILI9341_STM32_Driver.h"
#include "ILI9341_Touchscreen.h"
/* USER CODE END Includes */

/* Private typedef -----------------------------------------------------------*/
/* USER CODE BEGIN PTD */

/* USER CODE END PTD */

/* Private define ------------------------------------------------------------*/
/* USER CODE BEGIN PD */
#define LD2_Pin GPIO_PIN_7
#define LD3_Pin GPIO_PIN_14

#define LIGHT_RED    0xFDB5
#define LIGHT_GREEN  0xC718
#define LIGHT_BLUE   0xAEDF
/* USER CODE END PD */

/* Private macro -------------------------------------------------------------*/
/* USER CODE BEGIN PM */

/* USER CODE END PM */

/* Private variables ---------------------------------------------------------*/

/* USER CODE BEGIN PV */
float h=30.0, t=40.0;
uint8_t step;
HAL_StatusTypeDef status;
uint8_t r_percent = 0, g_percent = 0, b_percent = 0;
const uint16_t profile[] = {
		0xff,0xff,0xff,0xff,0xff,0xff,0xff,0xff,0xff,0xff,0xff,0xff,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0xff
		,0xff,0xff,0xff,0xff,0xff,0xff,0xff,0xff,0xff,0xff,0xff,0xff,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0xff
		,0xff,0xff,0xff,0xff,0xff,0xff,0xff,0xff,0xff,0xff,0xff,0xff,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0xff
		,0xff,0xff,0xff,0xff,0xff,0xff,0xff,0xff,0xff,0xff,0xff,0xff,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0xff
		,0xff,0xff,0xff,0xff,0xff,0xff,0xff,0xff,0xff,0xff,0xff,0xff,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0xff
		,0xff,0xff,0xff,0xff,0xff,0xff,0xff,0xff,0xff,0xff,0xff,0xff,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0xff
		,0xff,0xff,0xff,0xff,0xff,0xff,0xff,0xff,0xff,0xff,0xff,0xff,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0xff
		,0xff,0xff,0xff,0xff,0xff,0xff,0xff,0xff,0xff,0xff,0xff,0xff,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0xff
		,0xff,0xff,0xff,0xff,0xff,0xff,0xff,0xff,0xff,0xff,0xff,0xff,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0xff
		,0xff,0xff,0xff,0xff,0xff,0xff,0xff,0xff,0xff,0xff,0xff,0xff,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0xff
		,0xff,0xff,0xff,0xff,0xff,0xff,0xff,0xff,0xff,0xff,0xff,0xff,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0xff
		,0xff,0xff,0xff,0xff,0xff,0xff,0xff,0xff,0xff,0xff,0xff,0xff,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0xff
		,0xff,0xff,0xff,0xff,0xff,0xff,0xff,0xff,0xff,0xff,0xff,0xff,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0xff
		,0xff,0xff,0xff,0xff,0xff,0xff,0xff,0xff,0xff,0xff,0xff,0xff,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0xff
		,0xff,0xff,0xff,0xff,0xff,0xff,0xff,0xff,0xff,0xff,0xff,0xff,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0xff
		,0xff,0xff,0xff,0xff,0xff,0xff,0xff,0xff,0xff,0xff,0xff,0xff,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0xff
		,0xff,0xff,0xff,0xff,0xff,0xff,0xff,0xff,0xff,0xff,0xff,0xff,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0xff
		,0xff,0xff,0xff,0xff,0xff,0xff,0xff,0xff,0xff,0xff,0xff,0xff,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0xff
		,0xff,0xff,0xff,0xff,0xff,0xff,0xff,0xff,0xff,0xff,0xff,0xff,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0xff
		,0xff,0xff,0xff,0xff,0xff,0xff,0xff,0xff,0xff,0xff,0xff,0xff,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0xff
		,0xff,0xff,0xff,0xff,0xff,0xff,0xff,0xff,0xff,0xff,0xff,0xff,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0xff
		,0xff,0xff,0xff,0xff,0xff,0xff,0xff,0xff,0xff,0xff,0xff,0xff,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0xff
		,0xff,0xff,0xff,0xff,0xff,0xff,0xff,0xff,0xff,0xff,0xff,0xff,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0xff
		,0xff,0xff,0xff,0xff,0xff,0xff,0xff,0xff,0xff,0xff,0xff,0xff,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0xff
		,0xff,0xff,0xff,0xff,0xff,0xff,0xff,0xff,0xff,0xff,0xff,0xff,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0xff
		,0xff,0xff,0xff,0xff,0xff,0xff,0xff,0xff,0xff,0xff,0xff,0xff,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0xff
		,0xff,0xff,0xff,0xff,0xff,0xff,0xff,0xff,0xff,0xff,0xff,0xff,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0xff
		,0xff,0xff,0xff,0xff,0xff,0xff,0xff,0xff,0xff,0xff,0xff,0xff,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0xff
		,0xff,0xff,0xff,0xff,0xff,0xff,0xff,0xff,0xff,0xff,0xff,0xff,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0xff
		,0xff,0xff,0xff,0xff,0xff,0xff,0xff,0xff,0xff,0xff,0xff,0xff,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0xff
		,0xff,0xff,0xff,0xff,0xff,0xff,0xff,0xff,0xff,0xff,0xff,0xff,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0xff
		,0xff,0xff,0xff,0xff,0xff,0xff,0xff,0xff,0xff,0xff,0xff,0xff,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0xff
		,0xff,0xff,0xff,0xff,0xff,0xff,0xff,0xff,0xff,0xff,0xff,0xff,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0xff
		,0xff,0xff,0xff,0xff,0xff,0xff,0xff,0xff,0xff,0xff,0xff,0xff,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0xff
		,0xff,0xff,0xff,0xff,0xff,0xff,0xff,0xff,0xff,0xff,0xff,0xff,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0xff
		,0xff,0xff,0xff,0xff,0xff,0xff,0xff,0xff,0xff,0xff,0xff,0xff,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0xff
		,0xff,0xff,0xff,0xff,0xff,0xff,0xff,0xff,0xff,0xff,0xff,0xff,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0xff
		,0xff,0xff,0xff,0xff,0xff,0xff,0xff,0xff,0xff,0xff,0xff,0xff,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0xff
		,0xff,0xff,0xff,0xff,0xff,0xff,0xff,0xff,0xff,0xff,0xff,0xff,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0xff
		,0xff,0xff,0xff,0xff,0xff,0xff,0xff,0xff,0xff,0xff,0xff,0xff,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0xff
		,0xff,0xff,0xff,0xff,0xff,0xff,0xff,0xff,0xff,0xff,0xff,0xff,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0xff
		,0xff,0xff,0xff,0xff,0xff,0xff,0xff,0xff,0xff,0xff,0xff,0xff,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0xff
		,0xff,0xff,0xff,0xff,0xff,0xff,0xff,0xff,0xff,0xff,0xff,0xff,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0xff
		,0xff,0xff,0xff,0xff,0xff,0xff,0xff,0xff,0xff,0xff,0xff,0xff,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0xff
		,0xff,0xff,0xff,0xff,0xff,0xff,0xff,0xff,0xff,0xff,0xff,0xff,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0xff
		,0xff,0xff,0xff,0xff,0xff,0xff,0xff,0xff,0xff,0xff,0xff,0xff,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0xff
		,0xff,0xff,0xff,0xff,0xff,0xff,0xff,0xff,0xff,0xff,0xff,0xff,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0xff
		,0xff,0xff,0xff,0xff,0xff,0xff,0xff,0xff,0xff,0xff,0xff,0xff,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0xff
		,0xff,0xff,0xff,0xff,0xff,0xff,0xff,0xff,0xff,0xff,0xff,0xff,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0xff
		,0xff,0xff,0xff,0xff,0xff,0xff,0xff,0xff,0xff,0xff,0xff,0xff,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0xff
		,0xff,0xff,0xff,0xff,0xff,0xff,0xff,0xff,0xff,0xff,0xff,0xff,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0xff
		,0xff,0xff,0xff,0xff,0xff,0xff,0xff,0xff,0xff,0xff,0xff,0xff,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0xff
		,0xff,0xff,0xff,0xff,0xff,0xff,0xff,0xff,0xff,0xff,0xff,0xff,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0xff
		,0xff,0xff,0xff,0xff,0xff,0xff,0xff,0xff,0xff,0xff,0xff,0xff,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0xff
		,0xff,0xff,0xff,0xff,0xff,0xff,0xff,0xff,0xff,0xff,0xff,0xff,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0xff
		,0xff,0xff,0xff,0xff,0xff,0xff,0xff,0xff,0xff,0xff,0xff,0xff,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0xff
		,0xff,0xff,0xff,0xff,0xff,0xff,0xff,0xff,0xff,0xff,0xff,0xff,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0xff
		,0xff,0xff,0xff,0xff,0xff,0xff,0xff,0xff,0xff,0xff,0xff,0xff,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0xff
		,0xff,0xff,0xff,0xff,0xff,0xff,0xff,0xff,0xff,0xff,0xff,0xff,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0xff
		,0xff,0xff,0xff,0xff,0xff,0xff,0xff,0xff,0xff,0xff,0xff,0xff,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0xff
		,0xff,0xff,0xff,0xff,0xff,0xff,0xff,0xff,0xff,0xff,0xff,0xff,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0xff
		,0xff,0xff,0xff,0xff,0xff,0xff,0xff,0xff,0xff,0xff,0xff,0xff,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0xff
		,0xff,0xff,0xff,0xff,0xff,0xff,0xff,0xff,0xff,0xff,0xff,0xff,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0xff
		,0xff,0xff,0xff,0xff,0xff,0xff,0xff,0xff,0xff,0xff,0xff,0xff,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0xff
		,0xff,0xff,0xff,0xff,0xff,0xff,0xff,0xff,0xff,0xff,0xff,0xff,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0xff
		,0xff,0xff,0xff,0xff,0xff,0xff,0xff,0xff,0xff,0xff,0xff,0xff,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0xff
		,0xff,0xff,0xff,0xff,0xff,0xff,0xff,0xff,0xff,0xff,0xff,0xff,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0xff
		,0xff,0xff,0xff,0xff,0xff,0xff,0xff,0xff,0xff,0xff,0xff,0xff,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0xff
		,0xff,0xff,0xff,0xff,0xff,0xff,0xff,0xff,0xff,0xff,0xff,0xff,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0xff
		,0xff,0xff,0xff,0xff,0xff,0xff,0xff,0xff,0xff,0xff,0xff,0xff,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0xff
		,0xff,0xff,0xff,0xff,0xff,0xff,0xff,0xff,0xff,0xff,0xff,0xff,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0xff
		,0xff,0xff,0xff,0xff,0xff,0xff,0xff,0xff,0xff,0xff,0xff,0xff,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0xff
		,0xff,0xff,0xff,0xff,0xff,0xff,0xff,0xff,0xff,0xff,0xff,0xff,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0xff
		,0xff,0xff,0xff,0xff,0xff,0xff,0xff,0xff,0xff,0xff,0xff,0xff,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0xff
		,0xff,0xff,0xff,0xff,0xff,0xff,0xff,0xff,0xff,0xff,0xff,0xff,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0xff
		,0xff,0xff,0xff,0xff,0xff,0xff,0xff,0xff,0xff,0xff,0xff,0xff,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0xff
		,0xff,0xff,0xff,0xff,0xff,0xff,0xff,0xff,0xff,0xff,0xff,0xff,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0xff
		,0xff,0xff,0xff,0xff,0xff,0xff,0xff,0xff,0xff,0xff,0xff,0xff,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0xff
		,0xff,0xff,0xff,0xff,0xff,0xff,0xff,0xff,0xff,0xff,0xff,0xff,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0xff
		,0xff,0xff,0xff,0xff,0xff,0xff,0xff,0xff,0xff,0xff,0xff,0xff,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0xff
		,0xff,0xff,0xff,0xff,0xff,0xff,0xff,0xff,0xff,0xff,0xff,0xff,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0xff
		,0xff,0xff,0xff,0xff,0xff,0xff,0xff,0xff,0xff,0xff,0xff,0xff,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0xff
		,0xff,0xff,0xff,0xff,0xff,0xff,0xff,0xff,0xff,0xff,0xff,0xff,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0xff
		,0xff,0xff,0xff,0xff,0xff,0xff,0xff,0xff,0xff,0xff,0xff,0xff,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0xff
		,0xff,0xff,0xff,0xff,0xff,0xff,0xff,0xff,0xff,0xff,0xff,0xff,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0xff
		,0xff,0xff,0xff,0xff,0xff,0xff,0xff,0xff,0xff,0xff,0xff,0xff,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0xff
		,0xff,0xff,0xff,0xff,0xff,0xff,0xff,0xff,0xff,0xff,0xff,0xff,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0xff
		,0xff,0xff,0xff,0xff,0xff,0xff,0xff,0xff,0xff,0xff,0xff,0xff,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0xff
		,0xff,0xff,0xff,0xff,0xff,0xff,0xff,0xff,0xff,0xff,0xff,0xff,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0xff
		,0xff,0xff,0xff,0xff,0xff,0xff,0xff,0xff,0xff,0xff,0xff,0xff,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0xff
		,0xff,0xff,0xff,0xff,0xff,0xff,0xff,0xff,0xff,0xff,0xdf,0xbb,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0xff
		,0xff,0xff,0xff,0xff,0xff,0xff,0xff,0xdf,0xdb,0xdb,0xdb,0xdb,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0xdf
		,0xff,0xff,0xff,0xff,0xdf,0xdb,0xdb,0xdb,0xdf,0xdf,0xdf,0xdf,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0xdb
		,0xff,0xff,0xdf,0xdb,0xdf,0xdf,0xdf,0xdf,0xdf,0xdf,0xdf,0xdf,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0xdf
		,0xdf,0xdf,0xdf,0xdf,0xdf,0xdf,0xdf,0xdf,0xdf,0xdf,0xdf,0xdf,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0xdf
		,0xdf,0xdf,0xdf,0xdf,0xdf,0xdf,0xdf,0xdf,0xdf,0xdf,0xdf,0xdf,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0xdf
		,0xdf,0xdf,0xdf,0xdf,0xdf,0xdf,0xdf,0xdf,0xdf,0xdf,0xdf,0xdf,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0xdf
		,0xdf,0xdf,0xdf,0xdf,0xdf,0xdf,0xdf,0xdf,0xdf,0xdf,0xdf,0xdf,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0xdf
		,0xdf,0xff,0xdf,0xdf,0xdf,0xdf,0xdf,0xdf,0xdf,0xdf,0xdf,0xdf,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0xdf
		,0xdf,0xff,0xdf,0xdf,0xdf,0xdf,0xdf,0xdf,0xdf,0xff,0xdf,0xdf,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0xdf
		,0xff,0xdf,0xdf,0xdf,0xdf,0xdf,0xdf,0xdf,0xdf,0xff,0xdf,0xdf,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0xdf
		,0xff,0xff,0xff,0xdf,0xdf,0xdf,0xdf,0xdf,0xdf,0xff,0xdf,0xdf,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0xdf
		,0xff,0xff,0xff,0xdf,0xdf,0xdf,0xdf,0xdf,0xdf,0xff,0xdf,0xdf,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0xdf
		,0xdf,0xdf,0xff,0xdf,0xdf,0xdf,0xdf,0xdf,0xff,0xff,0xff,0xff,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0xdf
		,0xff,0xdf,0xff,0xff,0xff,0xdf,0xdf,0xdf,0xff,0xff,0xff,0xff,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0xdf
		,0xff,0xff,0xff,0xff,0xff,0xdf,0xdf,0xdf,0xff,0xff,0xff,0xff,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0xff
		,0xff,0xff,0xff,0xff,0xff,0xff,0xdf,0xdf,0xdf,0xff,0xff,0xff,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0xff
		,0xff,0xff,0xff,0xff,0xff,0xff,0xff,0xdf,0xdf,0xff,0xff,0xff,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0xff
		,0xdf,0xff,0xff,0xff,0xff,0xff,0xff,0xdf,0xdf,0xff,0xff,0xff,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0xdf
		,0xdf,0xdf,0xff,0xff,0xff,0xff,0xff,0xdf,0xdf,0xff,0xff,0xff,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0xdf
		,0xdf,0xdf,0xff,0xff,0xff,0xff,0xff,0xdf,0xdf,0xff,0xdf,0xff,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0xff
		,0xdf,0xdf,0xff,0xff,0xff,0xff,0xff,0xff,0xff,0xff,0xff,0xff,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0xff
		,0xdb,0xdf,0xdf,0xff,0xff,0xff,0xff,0xff,0xff,0xff,0xff,0xff,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0xff
		,0xdb,0xdf,0xff,0xff,0xff,0xff,0xff,0xff,0xff,0xff,0xff,0xff,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0xff
		,0xbb,0xdf,0xdf,0xff,0xff,0xff,0xff,0xff,0xff,0xff,0xff,0xff,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0xff
		,0xbb,0xdb,0xdf,0xff,0xff,0xff,0xff,0xff,0xff,0xff,0xff,0xff,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0xff
		,0xdb,0xdb,0xdf,0xdf,0xff,0xff,0xff,0xff,0xff,0xff,0xff,0xff,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0xff
		,0xdb,0xdb,0xdf,0xdf,0xff,0xff,0xff,0xff,0xff,0xff,0xff,0xff,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0xff
		,0xdb,0xbb,0xdf,0xdf,0xdf,0xff,0xff,0xff,0xff,0xff,0xff,0xff,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0xff
		,0xdf,0xbb,0xdf,0xdf,0xdf,0xdf,0xff,0xff,0xff,0xff,0xff,0xff,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0xff
};
/* USER CODE END PV */

/* Private function prototypes -----------------------------------------------*/
void SystemClock_Config(void);
/* USER CODE BEGIN PFP */
uint16_t CRC16_2(uint8_t*, uint8_t);
uint16_t MixedColor(uint8_t, uint8_t, uint8_t);
void Render_Dashboard(void);
void Render_Information(void);
void ILI9341_Draw_Small_Image(const uint16_t*, uint16_t, uint16_t, uint16_t, uint16_t);
/* USER CODE END PFP */

/* Private user code ---------------------------------------------------------*/
/* USER CODE BEGIN 0 */

/* USER CODE END 0 */

/**
  * @brief  The application entry point.
  * @retval int
  */
int main(void)
{

  /* USER CODE BEGIN 1 */
	char str[50];
	uint8_t cmdBuffer[3];
	uint8_t dataBuffer[8];
  /* USER CODE END 1 */

  /* Enable the CPU Cache */

  /* Enable I-Cache---------------------------------------------------------*/
  SCB_EnableICache();

  /* Enable D-Cache---------------------------------------------------------*/
  SCB_EnableDCache();

  /* MCU Configuration--------------------------------------------------------*/

  /* Reset of all peripherals, Initializes the Flash interface and the Systick. */
  HAL_Init();

  /* USER CODE BEGIN Init */

  /* USER CODE END Init */

  /* Configure the system clock */
  SystemClock_Config();

  /* USER CODE BEGIN SysInit */

  /* USER CODE END SysInit */

  /* Initialize all configured peripherals */
  MX_GPIO_Init();
  MX_SPI5_Init();
  MX_RNG_Init();
  MX_TIM1_Init();
  MX_I2C1_Init();
  MX_USART3_UART_Init();
  /* USER CODE BEGIN 2 */
  sprintf(str, "\n\rAM2320 I2C DEMO Starting...\n\r");
  HAL_UART_Transmit(&huart3, (uint8_t*)str, strlen(str), 200);

  cmdBuffer[0] = 0x03;
  cmdBuffer[1] = 0x00;
  cmdBuffer[2] = 0x04;

  ILI9341_Init();
  ILI9341_Set_Rotation(SCREEN_HORIZONTAL_1);
  ILI9341_Fill_Screen(WHITE);
//  Render_Dashboard();
  /* USER CODE END 2 */

  /* Infinite loop */
  /* USER CODE BEGIN WHILE */
  while (1)
  {
    /* USER CODE END WHILE */

    /* USER CODE BEGIN 3 */
	sprintf(str, "Temp = %4.1f\tHumidity = %4.1f\n\r", t, h);
	while(__HAL_UART_GET_FLAG(&huart3, UART_FLAG_TC) == 0) {}
	HAL_UART_Transmit(&huart3, (uint8_t*)str, strlen(str), 200);

	HAL_I2C_Master_Transmit(&hi2c1, 0x5c<<1, cmdBuffer, 3, 200);

	HAL_I2C_Master_Transmit(&hi2c1, 0x5c<<1, cmdBuffer, 3, 200);

	HAL_Delay(1);

	HAL_I2C_Master_Receive(&hi2c1, 0x5c<<1, dataBuffer, 8, 200);

	uint16_t Rcrc = dataBuffer[7] << 8;
	Rcrc += dataBuffer[6];

	if (Rcrc == CRC16_2(dataBuffer, 6))
	{
		uint16_t temperature = ((dataBuffer[4] & 0x7F) << 8) + dataBuffer[5];
		t = temperature / 10.0;
		t = (((dataBuffer[4] & 0x80) >> 7) == 1) ? (t * (-1)) : t;

		uint16_t humidity = (dataBuffer[2] << 8) + dataBuffer[3];
		h = humidity / 10.0;

		Render_Dashboard();
	}

	if (TP_Touchpad_Pressed())
	{
		uint16_t x_touch, y_touch;
	    uint16_t pos[2];

	    if (TP_Read_Coordinates(pos) == TOUCHPAD_DATA_OK)
	    {
	    	x_touch = pos[0];
	        y_touch = pos[1];

	        uint16_t x_screen = y_touch;
	        uint16_t y_screen = 240 - x_touch;

			if (x_screen > 20 && x_screen < 60 && y_screen > 80 && y_screen < 120)
			{
				r_percent = (r_percent >= 100) ? 0 : r_percent + 10;
				Render_Dashboard();
				HAL_Delay(200);
			}
			else if (x_screen > 20 && x_screen < 60 && y_screen > 130 && y_screen < 170)
			{
				g_percent = (g_percent >= 100) ? 0 : g_percent + 10;
				Render_Dashboard();
				HAL_Delay(200);
			}
			else if (x_screen > 20 && x_screen < 60 && y_screen > 180 && y_screen < 220) {
				b_percent = (b_percent >= 100) ? 0 : b_percent + 10;
				Render_Dashboard();
				HAL_Delay(200);
			}
			else if (x_screen > 120 && x_screen < 140 && y_screen > 30 && y_screen < 50) {
				ILI9341_Fill_Screen(WHITE);
				Render_Information();
				HAL_Delay(5000);
				ILI9341_Fill_Screen(WHITE);
			}
	    }
	}
  }
  /* USER CODE END 3 */
}

/**
  * @brief System Clock Configuration
  * @retval None
  */
void SystemClock_Config(void)
{
  RCC_OscInitTypeDef RCC_OscInitStruct = {0};
  RCC_ClkInitTypeDef RCC_ClkInitStruct = {0};

  /** Configure the main internal regulator output voltage
  */
  __HAL_RCC_PWR_CLK_ENABLE();
  __HAL_PWR_VOLTAGESCALING_CONFIG(PWR_REGULATOR_VOLTAGE_SCALE1);

  /** Initializes the RCC Oscillators according to the specified parameters
  * in the RCC_OscInitTypeDef structure.
  */
  RCC_OscInitStruct.OscillatorType = RCC_OSCILLATORTYPE_HSI;
  RCC_OscInitStruct.HSIState = RCC_HSI_ON;
  RCC_OscInitStruct.HSICalibrationValue = RCC_HSICALIBRATION_DEFAULT;
  RCC_OscInitStruct.PLL.PLLState = RCC_PLL_ON;
  RCC_OscInitStruct.PLL.PLLSource = RCC_PLLSOURCE_HSI;
  RCC_OscInitStruct.PLL.PLLM = 8;
  RCC_OscInitStruct.PLL.PLLN = 200;
  RCC_OscInitStruct.PLL.PLLP = RCC_PLLP_DIV2;
  RCC_OscInitStruct.PLL.PLLQ = 9;
  RCC_OscInitStruct.PLL.PLLR = 2;
  if (HAL_RCC_OscConfig(&RCC_OscInitStruct) != HAL_OK)
  {
    Error_Handler();
  }

  /** Activate the Over-Drive mode
  */
  if (HAL_PWREx_EnableOverDrive() != HAL_OK)
  {
    Error_Handler();
  }

  /** Initializes the CPU, AHB and APB buses clocks
  */
  RCC_ClkInitStruct.ClockType = RCC_CLOCKTYPE_HCLK|RCC_CLOCKTYPE_SYSCLK
                              |RCC_CLOCKTYPE_PCLK1|RCC_CLOCKTYPE_PCLK2;
  RCC_ClkInitStruct.SYSCLKSource = RCC_SYSCLKSOURCE_PLLCLK;
  RCC_ClkInitStruct.AHBCLKDivider = RCC_SYSCLK_DIV1;
  RCC_ClkInitStruct.APB1CLKDivider = RCC_HCLK_DIV4;
  RCC_ClkInitStruct.APB2CLKDivider = RCC_HCLK_DIV2;

  if (HAL_RCC_ClockConfig(&RCC_ClkInitStruct, FLASH_LATENCY_6) != HAL_OK)
  {
    Error_Handler();
  }
}

/* USER CODE BEGIN 4 */
uint16_t CRC16_2(uint8_t *ptr, uint8_t length)
{
	uint16_t crc = 0xFFFF;
	uint8_t s = 0x00;

	while(length--)
	{
		crc ^= *ptr++;
		for(s=0; s<8; s++)
		{
			if((crc & 0x01) != 0)
			{
				crc >>= 1;
				crc ^= 0xA001;
			} else crc >>= 1;
		}
	}

	return crc;
}

uint16_t MixedColor(uint8_t r, uint8_t g, uint8_t b)
{
	return (((r_percent * 31 / 100) << 11) | ((g_percent * 63 / 100) << 5) | ((b_percent * 31 / 100)));
}

void ILI9341_Draw_Small_Image(const uint16_t* image, uint16_t x, uint16_t y, uint16_t width, uint16_t height)
{
    ILI9341_Set_Address(x, y, x + width - 1, y + height - 1);

    for (uint32_t i = 0; i < (width * height); i++) {
        uint16_t color = image[i];

        uint8_t data[] = { (color >> 8) & 0xFF, color & 0xFF };
        ILI9341_Write_Data(data[0]);
        ILI9341_Write_Data(data[1]);
    }
}

void Render_Dashboard() {
    uint16_t mixed_color = MixedColor(r_percent, g_percent, b_percent);

    // Mixed Color
    ILI9341_Draw_Filled_Circle(130, 40, 20, mixed_color);

    // Red
    ILI9341_Draw_Filled_Circle(40, 100, 20, RED);
    ILI9341_Draw_Filled_Rectangle_Coord(80, 90, 200, 115, LIGHT_RED);
    ILI9341_Draw_Filled_Rectangle_Coord(80, 90, 80 + (r_percent * 120 / 100), 115, RED);

    // Green
    ILI9341_Draw_Filled_Circle(40, 150, 20, GREEN);
    ILI9341_Draw_Filled_Rectangle_Coord(80, 140, 200, 165, LIGHT_GREEN);
    ILI9341_Draw_Filled_Rectangle_Coord(80, 140, 80 + (g_percent * 120 / 100), 165, GREEN);

    // Blue
    ILI9341_Draw_Filled_Circle(40, 200, 20, BLUE);
    ILI9341_Draw_Filled_Rectangle_Coord(80, 190, 200, 215, LIGHT_BLUE);
    ILI9341_Draw_Filled_Rectangle_Coord(80, 190, 80 + (b_percent * 120 / 100), 215, BLUE);

    char buff[10];
    sprintf(buff, "%4.1fC", t);
    ILI9341_Draw_Text(buff, 30, 30, BLACK, 2, WHITE);
    sprintf(buff, "%4.1f%%RH", h);
    ILI9341_Draw_Text(buff, 165, 30, BLACK, 2, WHITE);

    sprintf(buff, "%d%%  ", r_percent);
    ILI9341_Draw_Text(buff, 205, 95, BLACK, 2, WHITE);
    sprintf(buff, "%d%%  ", g_percent);
    ILI9341_Draw_Text(buff, 205, 145, BLACK, 2, WHITE);
    sprintf(buff, "%d%%  ", b_percent);
    ILI9341_Draw_Text(buff, 205, 195, BLACK, 2, WHITE);
}

void Render_Information()
{
	uint16_t mixed_color = MixedColor(r_percent, g_percent, b_percent);

	ILI9341_Draw_Small_Image((uint16_t*)profile, 10, 50, 90, 120);

	char buff[20];
	sprintf(buff, "Group No.5026");
	ILI9341_Draw_Text(buff, 110, 50, mixed_color, 2, WHITE);

	sprintf(buff, "Chatnarint");
	ILI9341_Draw_Text(buff, 110, 80, mixed_color, 2, WHITE);

	sprintf(buff, "Boonsaeng");
	ILI9341_Draw_Text(buff, 110, 110, mixed_color, 2, WHITE);

	sprintf(buff, "67015026");
	ILI9341_Draw_Text(buff, 110, 140, mixed_color, 2, WHITE);
}
/* USER CODE END 4 */

/**
  * @brief  This function is executed in case of error occurrence.
  * @retval None
  */
void Error_Handler(void)
{
  /* USER CODE BEGIN Error_Handler_Debug */
  /* User can add his own implementation to report the HAL error return state */
  __disable_irq();
  while (1)
  {
  }
  /* USER CODE END Error_Handler_Debug */
}
#ifdef USE_FULL_ASSERT
/**
  * @brief  Reports the name of the source file and the source line number
  *         where the assert_param error has occurred.
  * @param  file: pointer to the source file name
  * @param  line: assert_param error line source number
  * @retval None
  */
void assert_failed(uint8_t *file, uint32_t line)
{
  /* USER CODE BEGIN 6 */
  /* User can add his own implementation to report the file name and line number,
     ex: printf("Wrong parameters value: file %s on line %d\r\n", file, line) */
  /* USER CODE END 6 */
}
#endif /* USE_FULL_ASSERT */
